## config/west.yml
```yaml
manifest:
  defaults:
    remote: urob

  remotes:
    - name: urob
      url-base: https://github.com/urob
    - name: zmkfirmware
      url-base: https://github.com/zmkfirmware
    # Additional modules containing boards/shields/custom code can be listed here as well
    # See https://docs.zephyrproject.org/3.2.0/develop/west/manifest.html#projects
  projects:
    - name: zmk
      remote: zmkfirmware
      revision: v0.3
      import: app/west.yml
    - name: zmk-adaptive-key
      path: modules/zmk/adaptive-key
      revision: v0.3
    - name: zmk-auto-layer
      path: modules/zmk/auto-layer
      revision: v0.3
    - name: zmk-helpers
      path: modules/zmk/helpers
      revision: v0.3
    - name: zmk-tri-state
      path: modules/zmk/tri-state
      revision: v0.3
  self:
    path: config
```
